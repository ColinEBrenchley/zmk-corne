## config/boards/shields/corne/Kconfig
```kconfig
if SHIELD_CORNE

config ZMK_DISPLAY_STATUS_SCREEN_CUSTOM
    default y
    select ZMK_DISPLAY
    select ZMK_WIDGET_WPM_STATUS
    select LV_USE_LABEL
    select LV_FONT_MONTSERRAT_12
    select LV_FONT_MONTSERRAT_14

endif # SHIELD_CORNE
```
